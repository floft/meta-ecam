## conf/bblayers.conf.sample
```bitbake
# LAYER_CONF_VERSION is increased each time build/conf/bblayers.conf
# changes incompatibly
LCONF_VERSION = "6"

BBPATH = "${TOPDIR}"
BBFILES ?= ""

BBLAYERS ?= " \
  ${HOME}/poky-dylan/meta \
  ${HOME}/poky-dylan/meta-yocto \
  ${HOME}/poky-dylan/meta-openembedded/meta-oe \
  ${HOME}/poky-dylan/meta-openembedded/meta-networking \
  ${HOME}/poky-dylan/meta-fsl-arm \
  ${HOME}/poky-dylan/meta-fsl-arm-extra \
  ${HOME}/poky-dylan/meta-gumstix \
  ${HOME}/poky-dylan/meta-beagleboard/common-bsp \
  ${HOME}/poky-dylan/meta-pansenti \
  ${HOME}/poky-dylan/meta-garrett \
  "

BBLAYERS_NON_REMOVABLE ?= " \
  ${HOME}/poky-dylan/meta \
  ${HOME}/poky-dylan/meta-yocto \
  "
```

## conf/layer.conf
```bitbake
# We have a conf directory, append to BBPATH
BBPATH .= ":${LAYERDIR}"

# We have a recipes directory, add to BBFILES
BBFILES += "${LAYERDIR}/recipes-*/*/*.bb ${LAYERDIR}/recipes-*/*/*.bbappend"

BBFILE_COLLECTIONS += "meta-garrett"
BBFILE_PATTERN_meta-garrett := "^${LAYERDIR}/"
BBFILE_PRIORITY_meta-garrett = "7"
```

## conf/local.conf.sample
```bitbake
# Local configuration for meta-ecam images
# Yocto Project 1.4 Poky distribution 9.0, [dylan] branch

BBMASK = "meta-beagleboard/meta-beagleboard-extras"
BBMASK .= "|meta-fsl-arm/recipes-graphics"
BBMASK .= "|meta-fsl-arm/recipes-qt"
BBMASK .= "|meta-fsl-arm-extra/recipes-core"

PREFERRED_PROVIDER_jpeg = "libjpeg-turbo"
PREFERRED_PROVIDER_udev = "udev"

DISTRO_FEATURES = "ext3 keyboard usbhost wifi ${DISTRO_FEATURES_LIBC}"

# Additional distro features you might want to add: 
# alsa, bluetooth, irda, nfc, nfs, pci, usbgadget, vfat, x11, zeroconf 

# force this output type for all MACHINES, significantly smaller in size
IMAGE_FSTYPES_forcevariable = "tar.xz"

# override the mix in the meta-gumstix/conf/machine configuration files
MACHINE_FEATURES_forcevariable = "ext3 screen serial usbhost"

BB_NUMBER_THREADS = "8"
PARALLEL_MAKE = "-j 8"

MACHINE ?= "overo"
# Uncomment the following PREFERRED_VERSION line only if there is some reason
# you need to run the 3.2 kernel on the Overo instead of the default 3.5.
# One reason would be if you are writing a custom McBSP kernel driver. 
PREFERRED_VERSION_linux-gumstix_overo = "3.2"

# The default TMPDIR is */build/tmp. You can override it here.
# TMPDIR = "/oe18/tmp-poky-dylan-build"

# The default download directory is */build/sources
# DL_DIR ?= "/oe-sources"

#SSTATE_DIR ?= "${TOPDIR}/sstate-cache"

DISTRO = "poky"

PACKAGE_CLASSES = "package_ipk"

# i686 or x86_64
SDKMACHINE = "i686"

EXTRA_IMAGE_FEATURES = "debug-tweaks"

USER_CLASSES ?= "image-mklibs image-prelink"

PATCHRESOLVE = "noop"

#
# Disk Space Monitoring during the build
#
# Monitor the disk space during the build. If there is less that 1GB of space or less
# than 100K inodes in any key build location (TMPDIR, DL_DIR, SSTATE_DIR), gracefully
# shutdown the build. If there is less that 100MB or 1K inodes, perform a hard abort
# of the build. The reason for this is that running completely out of space can corrupt
# files and damages the build in ways which may not be easily recoverable.
BB_DISKMON_DIRS = "\
    STOPTASKS,${TMPDIR},1G,100K \
    STOPTASKS,${DL_DIR},1G,100K \
    STOPTASKS,${SSTATE_DIR},1G,100K \
    ABORT,${TMPDIR},100M,1K \
    ABORT,${DL_DIR},100M,1K \
    ABORT,${SSTATE_DIR},100M,1K" 


CONF_VERSION = "1"
```
